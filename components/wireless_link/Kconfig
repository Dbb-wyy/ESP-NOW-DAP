## components/wireless_link/Kconfig
```kconfig
menu "Wireless Link Configuration"

    config WLINK_CHANNEL
        int "Wi-Fi channel used by the bridge link"
        range 1 13
        default 1
        help
            Both devices of a wireless bridge pair must use the same channel.
            The channel is fixed at start-up instead of following the station
            configuration, so the link also works when no access point is around.

    config WLINK_SWD_TIMEOUT_MS
        int "CMSIS-DAP response timeout (ms)"
        default 250
        help
            How long the wireless host waits for a DAP response from the slave
            before retransmitting the request.

    config WLINK_SWD_RETRIES
        int "CMSIS-DAP request retransmissions"
        range 1 10
        default 3
        help
            Number of times a DAP request is (re)sent before the relay gives up.
            Giving up lets OpenOCD time out and retry at a higher level.

    config WLINK_PEER_WAIT_MS
        int "How long the wireless host waits for the link to pair (ms)"
        default 2000
        help
            A board that has just been reset does not know its peer yet, while the
            host tool sends its first command as soon as the USB device enumerates
            and gives up if that command is not answered. Before sending a DAP
            request the relay waits up to this long for the link to pair, so the
            request can go out as an acknowledged unicast frame.

            After the wait the request is still sent (as a broadcast, which the
            slave receives as well), so this only trades a little latency at
            start-up for reliability.

    config WLINK_SWD_VERBOSE_LOG
        bool "Log every CMSIS-DAP packet on the SWD path at info level"
        default n
        help
            Logs each DAP request, each retransmission, each cache hit and each
            response at info level instead of debug level.

            Useful when diagnosing the wireless SWD path, because the host board's
            console is not always easy to reach. Keep it off for normal use: a debug
            session with a live watch can send hundreds of DAP commands per second,
            and the serial console is far slower than that, so the logging itself
            would slow the link down.

    config WLINK_DEBUG_LINK_TEST
        bool "Debug: send a link test line from the slave every second"
        default n
        depends on !BRIDGE_ROLE_WIRED
        help
            Debug aid for the wireless link itself.

            When enabled, the wireless slave sends the text "connected N" (N counting
            up from 1) to the host once per second, as soon as it has discovered its
            peer. The line travels as WLINK_MSG_SERIAL, so it takes exactly the same
            path as the tunnelled UART data: it shows up on the serial port of the USB
            side and is also logged on the slave console.

            A silent serial port therefore means the link is not paired (or the slave
            is not sending), while one line per second proves the whole path, not just
            the radio. Turn this off for normal use: the test text is injected into the
            UART tunnel and the log costs one line per second.

            Only the slave sends; enabling it on the host build only reports that the
            host has nothing to send.

endmenu
```
