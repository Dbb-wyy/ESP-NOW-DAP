## main/Kconfig.projbuild
```kconfig
menu "END-config"

    # ===================================================== role configuration

    menu "Role configuration"

        choice BRIDGE_ROLE
            prompt "Firmware role"
            default BRIDGE_ROLE_WIRELESS_HOST if SOC_USB_OTG_SUPPORTED
            default BRIDGE_ROLE_WIRELESS_SLAVE
            help
                Select which end of the bridge this firmware implements.

                Wired: a single chip carrying both ends, USB on one side and the target
                UART/JTAG/SWD plus the mass storage disk on the other.

                Wireless host: sits next to the PC. USB CDC and the CMSIS-DAP bulk
                interface are tunnelled over ESP-NOW to a wireless slave.

                Wireless slave: sits next to the target. Drives the target UART, the
                BOOT/RST pins and the CMSIS-DAP/SWD pins from the ESP-NOW link.

                Wired and wireless host need a USB OTG device controller, so they are
                only offered on targets that have one (ESP32-S2/S3/P4/H4). Targets
                without USB OTG (ESP32-C3/C6, ...) only offer the wireless slave.

                Both wireless roles require
                "END-config -> Role configuration -> Debug interface -> CMSIS-DAP SWD".

                The default is the wireless host on targets with a USB OTG controller
                and the wireless slave on the others, so a plain build produces the
                firmware for the board the chip can actually drive. The wired role is
                selected explicitly; sdkconfig.defaults.wired is a ready-made preset.

            config BRIDGE_ROLE_WIRED
                bool "Wired (USB only)"
                depends on SOC_USB_OTG_SUPPORTED

            config BRIDGE_ROLE_WIRELESS_HOST
                bool "Wireless host (USB <-> ESP-NOW)"
                depends on SOC_USB_OTG_SUPPORTED

            config BRIDGE_ROLE_WIRELESS_SLAVE
                bool "Wireless slave (ESP-NOW <-> target UART + SWD)"
        endchoice

        choice DEBUG_PROBE_INTERFACE
            prompt "Debug interface"
            default DEBUG_PROBE_IFACE_JTAG
            help
                Select which debug interface to use.

                The two wireless roles tunnel CMSIS-DAP, which only exists in the SWD
                build, so selecting ESP-USB JTAG together with a wireless role is a
                compile time error (see the #error in main/bridge_glue.c).

            config DEBUG_PROBE_IFACE_JTAG
                bool "ESP-USB JTAG"

            config DEBUG_PROBE_IFACE_SWD
                bool "CMSIS-DAP SWD"
        endchoice

        config DEBUG_PROBE_IFACE_NAME
            string
            default "JTAG" if DEBUG_PROBE_IFACE_JTAG
            default "CMSIS-DAP"

    endmenu

    # ====================================================== pin configuration

    menu "Pin configuration"

        menu "Debug probe pins"

            config DEBUG_PROBE_GPIO_TDI
                int "GPIO pin for the target TDI signal"
                default 3
                help
                    GPIO pin connected to target's TDI (Test Data Input) signal.

                    Only used by the JTAG build; the SWD build expands the macro but
                    never drives the pin, so it can stay at any value there.

            config DEBUG_PROBE_GPIO_TDO
                int "GPIO pin for the target TDO signal"
                default 9
                help
                    GPIO pin connected to target's TDO (Test Data Output) signal.

                    Only used by the JTAG build; the SWD build expands the macro but
                    never drives the pin, so it can stay at any value there.

            config DEBUG_PROBE_GPIO_TCK
                int "GPIO pin for the target TCK signal"
                default 10
                help
                    GPIO pin connected to target's TCK (Test Clock) signal. Also used as
                    SWCLK in the SWD build.

            config DEBUG_PROBE_GPIO_TMS
                int "GPIO pin for the target TMS signal"
                default 8
                help
                    GPIO pin connected to target's TMS (Test Mode Select) signal. Also
                    used as SWDIO in the SWD build.

        endmenu

        menu "Target serial + reset pins"

            config SERIAL_HANDLER_GPIO_BOOT
                int "GPIO pin for the BOOT signal"
                default 4
                help
                    GPIO pin connected to target's BOOT signal (active low)

            config SERIAL_HANDLER_GPIO_RST
                int "GPIO pin for the RESET signal"
                default 7
                help
                    GPIO pin connected to target's RESET signal (active low)

            config SERIAL_HANDLER_GPIO_RXD
                int "GPIO pin for the RxD signal"
                default 6
                help
                    GPIO pin for UART receive (RxD) from target

            config SERIAL_HANDLER_GPIO_TXD
                int "GPIO pin for the TxD signal"
                default 5
                help
                    GPIO pin for UART transmit (TxD) to target

        endmenu

        menu "Status LED"

            config BRIDGE_LED_ENABLE
                bool "Enable the WS2812 status LED"
                default y
                help
                    Enables the addressable (WS2812) status LED, which reports the state
                    of the bridge. In the wireless roles it breathes cyan while the
                    ESP-NOW link is up and flashes amber while it is down; the wired role
                    has no link to report and instead breathes white until traffic takes
                    over. In every role SWD activity flashes blue, serial activity
                    flashes green and both at once flash violet.

                    While disabled there is no LED pin at all: the pin option below is
                    not offered, no pin is configured, driven or reset, and the LED
                    helpers compile to stubs. It is enabled by default, but the pin
                    option below starts at -1, and -1 drives nothing: the board files
                    (sdkconfig.defaults.esp32s3 / .esp32c6) supply the real pin, so a
                    build for another board stays silent until one is filled in.

                    The LED is driven from the RMT peripheral through the managed
                    component espressif/led_strip, declared in
                    components/status_led/idf_component.yml.

            config BRIDGE_WS2812_GPIO
                int "GPIO connected to the WS2812 data input (-1 = none)"
                default -1
                depends on BRIDGE_LED_ENABLE
                help
                    GPIO number wired to the data input of the addressable RGB status LED
                    (WS2812/WS2812B), or -1 to drive nothing.

                    -1 is the default on purpose: an LED pin depends on the board, and a
                    wrong number would drive a pin that carries something else.

                    status_led_init() rejects a pin outside the chip's GPIO range, and a pin
                    already used by the target UART or the debug probe, because a status
                    LED must never fight a functional signal.

                    Most WS2812 parts want a 5 V supply; with a 3.3 V GPIO data line that
                    usually needs level shifting, and the first LED may need a supply
                    closer to 5 V to behave.

            config BRIDGE_LED_BRIGHTNESS
                int "Overall brightness (0-255)"
                range 0 255
                default 16
                depends on BRIDGE_LED_ENABLE
                help
                    Ceiling applied to every colour. 16 is a deliberately conservative
                    starting point: a WS2812 at full brightness is uncomfortably bright
                    for a status indicator and draws a lot of current.

                    It is also the number of codes the breath can use: cyan spans 0..45
                    codes at 64, 0..22 at 32, 0..11 at 16 and only 0..5 at 8. Very low
                    values leave so few levels that the ramp either steps or, once
                    dithered, pulses at a few hertz; below about 16 codes the renderer
                    stops dithering and shows the steps, so 32 and up is the smooth end.

            config BRIDGE_LED_ACT_WINDOW_MS
                int "Activity window (ms)"
                range 50 5000
                default 1000
                depends on BRIDGE_LED_ENABLE
                help
                    How long a single SWD packet or serial burst keeps its colour on
                    screen. OpenOCD can leave gaps of a few hundred milliseconds between
                    commands while stepping, so a window that is too short makes the LED
                    fall back to the idle colour in the middle of a session.

                    This is also the refresh rate of the state machine: the renderer
                    samples the state once every half window and only then decides
                    which colour and movement apply. Shorter window, snappier state
                    changes; longer window, the colour lingers after traffic stops.

            config BRIDGE_LED_SESSION_TIMEOUT_MS
                int "SWD session timeout (ms, 0 = only Disconnect ends it)"
                range 0 3600000
                default 0
                depends on BRIDGE_LED_ENABLE
                help
                    The blue "SWD in use" state is opened by the CMSIS-DAP Connect
                    command and closed by Disconnect, not by the traffic itself: a
                    debugger with a halted target can send nothing for minutes and still
                    be in the middle of a session, so traffic cannot end the state.

                    0 is the default and trusts the protocol: OpenOCD, pyOCD and
                    probe-rs all send Disconnect when they shut down. A non-zero value is
                    a safety net for a debugger that is killed before it can do so; the
                    cost is that a genuinely idle session is also ended after that much
                    silence.

            config BRIDGE_LED_BLINK_PERIOD_MS
                int "Blink period (ms)"
                range 100 10000
                default 1000
                depends on BRIDGE_LED_ENABLE
                help
                    Length of one on/off cycle for the flashing states (link down, SWD
                    activity, serial activity, both).

            config BRIDGE_LED_BLINK_ON_MS
                int "Blink on-time (ms)"
                range 10 10000
                default 500
                depends on BRIDGE_LED_ENABLE
                help
                    How much of each blink period the LED is lit. Must be shorter than
                    the blink period; a longer value simply means "always on".

            config BRIDGE_LED_BREATH_PERIOD_MS
                int "Breathing period (ms)"
                range 500 20000
                default 1000
                depends on BRIDGE_LED_ENABLE
                help
                    Length of one full fade down and back up for the idle state.

            config BRIDGE_LED_BREATH_MIN_PCT
                int "Breathing minimum brightness (%)"
                range 0 100
                default 0
                depends on BRIDGE_LED_ENABLE
                help
                    Brightness at the darkest point of the breath, as a percentage of
                    full scale; the global brightness is applied on top of it. 0 lets the
                    LED go fully dark each cycle.

            config BRIDGE_LED_GAMMA_X100
                int "Breathing gamma (x100)"
                range 100 400
                default 220
                depends on BRIDGE_LED_ENABLE
                help
                    Power law applied to the 0..255 level before it reaches the strip,
                    given as a hundredth: 220 is gamma 2.2. A WS2812 driven straight from
                    a linear ramp looks like it jumps near the bottom and stands still
                    near the top, because the eye is roughly a 2.2 power law; the curve
                    here compensates for that. 100 is the old linear ramp, for comparison.

                    The 256 entry lookup table is built once at init, so trying a value
                    costs nothing at run time.

        endmenu

    endmenu

    # ========================================================= wireless link

    menu "Wireless link"

        config WLINK_CHANNEL
            int "Wi-Fi channel used by the bridge link"
            range 1 13
            default 1
            help
                Both devices of a wireless bridge pair must use the same channel.
                The channel is fixed at start-up instead of following the station
                configuration, so the link also works when no access point is around.

        config WLINK_SWD_TIMEOUT_MS
            int "CMSIS-DAP response timeout (ms)"
            default 250
            help
                How long the wireless host waits for a DAP response from the slave
                before retransmitting the request.

        config WLINK_SWD_RETRIES
            int "CMSIS-DAP request retransmissions"
            range 1 10
            default 3
            help
                Number of times a DAP request is (re)sent before the relay gives up.
                Giving up lets OpenOCD time out and retry at a higher level.

        config WLINK_PEER_WAIT_MS
            int "How long the wireless host waits for the link to pair (ms)"
            default 2000
            help
                A board that has just been reset does not know its peer yet, while the
                host tool sends its first command as soon as the USB device enumerates
                and gives up if that command is not answered. Before sending a DAP
                request the relay waits up to this long for the link to pair, so the
                request can go out as an acknowledged unicast frame.

                After the wait the request is still sent (as a broadcast, which the
                slave receives as well), so this only trades a little latency at
                start-up for reliability.

        config WLINK_PEER_TIMEOUT_MS
            int "Peer considered lost after (ms)"
            range 500 60000
            default 3000
            help
                A peer that has been heard from more than this long ago is reported as
                lost, which turns the status LED yellow. Beacons arrive once per second,
                so the default tolerates two missed beacons before declaring the link
                down.

                This only feeds the status LED. The SWD relay keeps using
                WLINK_PEER_WAIT_MS and the response timeout above, so a link that is
                merely slow is not torn down.

    endmenu

    # ========================================================== USB identity

    menu "USB identity"

        config BRIDGE_USB_VID
            hex "USB vendor ID"
            default 0x303A
            help
                USB Vendor ID for the bridge device

        config BRIDGE_USB_PID
            hex "USB product ID"
            default 0x1002
            help
                USB Product ID for the bridge device

        config BRIDGE_MANUFACTURER
            string "USB bridge manufacturer"
            default "Espressif Systems Co. Ltd."
            help
                Manufacturer string shown in USB device descriptor

        config BRIDGE_PRODUCT_NAME
            string "USB product name"
            default "ESP USB Bridge"
            help
                Product name string shown in USB device descriptor

        config BRIDGE_DOWNLOAD_MAGIC_BAUD
            int "Magic baud rate to enter download mode"
            default 1200
            help
                When the host sets the CDC serial port to this baud rate, download
                mode reset is armed. Closing the port (clearing DTR) then resets the
                bridge chip (ESP32-S2 or ESP32-S3) into download mode so its firmware
                can be updated over USB. Do not use this baud for normal target
                serial traffic; any DTR clear while armed triggers bridge download
                mode. Prefer a baud that host tools will not use for the target.
                Set to 0 to disable.

    endmenu

    # ================================================================= debug

    menu "Debug"

        config WLINK_SWD_VERBOSE_LOG
            bool "Log every CMSIS-DAP packet on the SWD path at info level"
            default n
            help
                Logs each DAP request, each retransmission, each cache hit and each
                response at info level instead of debug level.

                Useful when diagnosing the wireless SWD path, because the host board's
                console is not always easy to reach. Keep it off for normal use: a debug
                session with a live watch can send hundreds of DAP commands per second,
                and the serial console is far slower than that, so the logging itself
                would slow the link down.

        config WLINK_DEBUG_LINK_TEST
            bool "Debug: send a link test line from the slave every second"
            default n
            depends on !BRIDGE_ROLE_WIRED
            help
                Debug aid for the wireless link itself.

                When enabled, the wireless slave sends the text "connected N" (N counting
                up from 1) to the host once per second, as soon as it has discovered its
                peer. The line travels as WLINK_MSG_SERIAL, so it takes exactly the same
                path as the tunnelled UART data: it shows up on the serial port of the USB
                side and is also logged on the slave console.

                A silent serial port therefore means the link is not paired (or the slave
                is not sending), while one line per second proves the whole path, not just
                the radio. Turn this off for normal use: the test text is injected into the
                UART tunnel and the log costs one line per second.

                Only the slave sends; enabling it on the host build only reports that the
                host has nothing to send.

    endmenu

endmenu
```
